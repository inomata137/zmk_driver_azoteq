## drivers/input/Kconfig
```kconfig
config INPUT_TPS43
    bool "Azoteq TPS43 I2C Touchpad Input Device"
    default y
    depends on DT_HAS_AZOTEQ_TPS43_ENABLED
    depends on I2C
    depends on INPUT
    help
      Enable driver for Azoteq touchpad input device over I2C interface.
      Supports multitouch gestures, scrolling, clicks and power management.

if INPUT_TPS43

config INPUT_TPS43_INIT_PRIORITY
    int "Init priority"
    default 90
    help
      Device driver initialization priority.

config INPUT_TPS43_WORKQUEUE_STACK_SIZE
    int "Work queue stack size"
    default 2048
    help
      Stack size of the dedicated work queue that reads trackpad events.

config INPUT_TPS43_WORKQUEUE_PRIORITY
    int "Work queue thread priority"
    default 5
    help
      Priority of the dedicated work queue that reads trackpad events.
      Keep it lower (numerically higher) than the system work queue and the
      input thread so that BLE TX completion and key scanning are never starved.

endif # ZMK_SENSOR_TPS43
```
